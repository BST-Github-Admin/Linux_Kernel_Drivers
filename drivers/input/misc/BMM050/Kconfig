## drivers/input/misc/BMM050/Kconfig
```kconfig
#
# Makefile for Bosch sensors driver.
#
config SENSORS_BMM050
	tristate "BMM050 Magnetic Sensor Driver"
	depends on I2C
	help
	 If you say yes here, you get support for Bosch Sensortec's
	 sensor BMM050 Magnetic Sensor
```
